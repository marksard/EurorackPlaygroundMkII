/*!
 * Oscillator class
 * Copyright 2024 marksard
 * This software is released under the MIT license.
 * see https://opensource.org/licenses/MIT
 */

#pragma once
#include <Arduino.h>

// pwm reso 2048, bias 1023
const uint16_t decayCurveSize = 1024; 
const uint16_t decayCurve[1024] = {
1024,1016,1008,1000,992,984,977,969,961,954,947,939,932,925,917,910,
903,896,889,882,875,869,862,855,848,842,835,829,822,816,810,803,
797,791,785,779,772,766,760,755,749,743,737,731,726,720,714,709,
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0,0,0,0,0,0,0,0,0,0,0,0,0,0,0,0};

template <typename vs = int16_t>
class SingleShotWave
{
public:
    SingleShotWave(const vs wave[], uint32_t waveLength)
    {
        init(wave, waveLength);
    }

    void init(const vs wave[], uint32_t waveLength)
    {
        _pWave = wave;
        _waveLength = waveLength;
        _start = false;
        _waveIndex = 0.0;
        _pitch = 1.0;
        _volume = 1.0;
        _bias = 1024;
        _decayIndex = 0.0;
        _decayValue = 0;
        _lastEdge = 0;
        // _lastValue = _bias;
        _mute = false;
    }

    uint16_t updateWave()
    {
        if (!_start)
            return _bias;

        int16_t value = _pWave[(int)_waveIndex];
        _waveIndex += _pitch;
        if (_waveIndex >= _waveLength)
        {
            _start = false;
            _waveIndex = 0.0;
            _decayIndex = 0.0;
            // _lastValue = _bias;
            return _bias;
        }

        if (_mute)
            return _bias;

        value = (uint16_t)((((int32_t)value * _decayValue) >> 10) + _bias);
        // simplest linear interpolation
        // value = (_lastValue + value) >> 1;
        // _lastValue = value;
        return value;
    }

    void play(int8_t edge)
    {
        if (_lastEdge == 0 && edge != 0)
        {
            _start = true;
            _waveIndex = 0.0;
            _decayIndex = 0.0;
        }
        _lastEdge = edge;
    }

    void updateDecay(float value)
    {
        float decay = (1.0 - value);
        _decayValue = decayCurve[(int)_decayIndex] * _volume;
        _decayIndex += decay;
        if (_decayIndex >= decayCurveSize)
        {
            _start = false;
        }
    }

    void setSpeed(float value) { _pitch = value; }

    void setBias(vs value) { _bias = value; }
    void setMute(bool value) { _mute = value; }
    void setVolume(float value) { _volume = value; }

private:
    const vs *_pWave;
    uint32_t _waveLength;
    bool _start;
    bool _mute;
    float _waveIndex;
    float _pitch;
    float _volume;
    vs _bias;
    // vs _lastValue;
    float _decayIndex;
    int16_t _decayValue;
    int8_t _lastEdge;
};
